
#include<reg52.h>
#include<stdio.h>
void UART_Init()
{
	TMOD = 0x20;
	TH1 = 0xFD;
	SCON = 0x50;
	TR1 = 1;
}
void UART_TxChar(char Data)
{
	SBUF = Data;
	while (TI==0);
	TI = 0;
}


char UART_RxChar()
{
	char dat;
	while (RI==0);
	RI = 0;
	dat = SBUF;
	return(dat);
}
	
void UART_SendString(char *str)
{
     int i;
     for(i=0;str[i]!=0;i++)
		{
         UART_TxChar(str[i]);
    }
}

sbit CLK=P0^1;
sbit DIN=P0^2;
sbit DC=P0^3;
sbit CE=P0^4;
sbit RST=P0^5;

void Send(unsigned char);
void Data(unsigned char);
void Cmd(unsigned char);
void setPixel(unsigned char, unsigned char);
void setCursor(unsigned char, unsigned char);
void allClear(void);
void Initialize_LCD(void);
void charDisp(unsigned char);
void stringDisp(unsigned char*);

const unsigned char code LookUpTable [][5] =
{
    { 0x00, 0x00, 0x00, 0x00, 0x00 },  // space
    { 0x00, 0x00, 0x2f, 0x00, 0x00 },   // !
    { 0x00, 0x07, 0x00, 0x07, 0x00 },   // "
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    { 0x00, 0x08, 0x3e, 0x41, 0x00 }    // {
};


void Send(unsigned char a){
	unsigned char i;
	for(i=0;i<8;i++){
		CLK = 0;
		if((a&0x80)){
			DIN = 1;
		} else {
			DIN = 0;
		}
		CLK = 1;
		a <<= 1;
	}
}


void Data(unsigned char x){
	DC = 1;
	CE = 0;
	Send(x);
	CE = 1;
}

void Cmd(unsigned char x){
	DC = 0;
	CE = 0;
	Send(x);
	CE = 1;
}
void setPixel(unsigned char x, unsigned char y)
{
	Cmd(0x40|(y&0x07));	// Y axis
	Cmd(0x80|(x&0x7f));	// X axis
}

void allClear(void)
{
	int pixel;
	setPixel(0,0);										// Cursor Home.
	for (pixel=504;pixel>0;pixel--)	{Data(0x00);}		// 6*84 = 504 DDRAM addresses.
}


void Initialize_LCD(void)
{
	RST = 1;	// Set _RES HIGH.
	CE = 1;		// Disable Chip.


	Cmd(0x21);		// Activate Chip and H=1.
	Cmd(0xb2);		// Set LCD Voltage to about 7V.
	Cmd(0x13);		// Adjust voltage bias.
	Cmd(0x20);		// Horizontal addressing and H=0.
	Cmd(0x09);		// Activate all segments.
	allClear();			// Erase all pixel on the DDRAM.
	Cmd(0x08);		// Blank the Display.
	Cmd(0x0C);		// Display Normal.
	setPixel(0,0);		// Cursor Home.
}

void setCursor(unsigned char row, unsigned char col){
	if((row>6) || (row<1) || (col<1) || (col>14))
		return;
	setPixel(((col-1)*6),(row-1));
}

/* Writes single character on LCD                   */
/* Input Arguments: ch -> Character to be displayed */
void charDisp(unsigned char a){
	unsigned char i, b;
	if ( (a < 0x20) || (a > 0x7c) ){
		a = 92;
	}
	for(i=0;i<5;i++){
		b = LookUpTable[a - 32][i] << 1;
		Data(b);
	}
	Data(0x00);
}

void stringDisp(unsigned char *p){
	while(*p)
		charDisp(*p++);
}

void Delay(int k)
{
	int i,j;
	for(i=0;i<k;i++)
	for(j=0;j<1000;j++);
}
		
void main(){
	int l;
	char RFID[15];
	UART_Init();	/* Initialize UART communication  */
	Initialize_LCD();
	//Bring Cursor to Line 1, character 1
	setCursor(1,1);
	setPixel(0,0);
	//Write gfx data on LCD
		while(1)
	{
		for(l=0;l<12;l++)
		{ 
			RFID[l]=UART_RxChar();
		}
		
		stringDisp(RFID);  
	}	
}
